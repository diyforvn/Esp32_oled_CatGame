#include <Arduino.h>
#include <Wire.h>
#include <Adafruit_GFX.h>
#include <Adafruit_SH110X.h>

// OLED setup
#define SCREEN_WIDTH 128
#define SCREEN_HEIGHT 64
#define OLED_RESET -1
#define I2C_ADDRESS 0x3C

Adafruit_SH1106G display(SCREEN_WIDTH, SCREEN_HEIGHT, &Wire, OLED_RESET);

// Nút nhấn 
#define BTN_LEFT  33
#define BTN_RIGHT 34

// ======================
// Bitmaps 
// ======================
static const uint8_t PROGMEM catIdle[] = {0x0, 0x0, 0x0, 0x0, 0x0, 0x0, 0x0, 0x0, 0x0, 0x0, 0x0, 0x0, 0x0,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 0x0, 0x1};
static const uint8_t PROGMEM catRightPaw[] = {0x0, 0x0, 0x0, 0x0, 0x0, 0x0, 0x0, 0x0, 0x0, 0x0, 0x0, 0x0, 0x0,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 0x0, 0x1};
static const uint8_t PROGMEM catLeftPaw[] = {0x0, 0x0, 0x0, 0x0, 0x0, 0x0, 0x0, 0x0, 0x0, 0x0, 0x0, 0x0, 0x0,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 0x0, 0x1};
static const uint8_t PROGMEM catBothPaws[] = {0x0, 0x0, 0x0, 0x0, 0x0, 0x0, 0x0, 0x0, 0x0, 0x0, 0x0, 0x0, 0x0,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 0x0, 0x1};


// ======================
// KHAI BÁO BIẾN GAME 
// ======================

// Trạng thái game
int score = 0;
int misses = 0;
bool gameOver = false;
int max_misses = 3;

// Thông số chuột
int mouse_x = 0;
int mouse_y = SCREEN_HEIGHT - 5; 
int mouse_width = 8;
int mouse_height = 5;
int mouse_direction = 1; // 1 = sang phải, -1 = sang trái
unsigned long mouse_last_move = 0;
int mouse_move_delay = 50; // Tốc độ ban đầu (ms cho mỗi pixel) - Càng nhỏ càng nhanh

// Trạng thái mèo
enum CatState { RESTING, LEFT_PAW, RIGHT_PAW, BOTH_PAWS };
CatState cat_state = RESTING;
unsigned long paw_down_timer = 0;
int paw_down_duration = 200; // Thời gian tay mèo giữ ở dưới (ms)

// Hiệu ứng "Vang" (Hit Effect)
bool hit_effect_active = false;
int hit_effect_x = 0;
int hit_effect_y = 0;
unsigned long hit_effect_timer = 0;
int hit_effect_duration = 150; // Thời gian hiển thị hiệu ứng (ms)

// Quản lý thời gian
unsigned long last_frame_time = 0;
int frame_delay = 33; // ~30 FPS (1000ms / 30)


#define VISUAL_LEFT_X_START 30
#define VISUAL_LEFT_X_END   50
#define VISUAL_RIGHT_X_START 78
#define VISUAL_RIGHT_X_END  98
// ------------------------------------------

// ======================
// HÀM HIỂN THỊ 
// ======================
void showCat(const uint8_t *bitmap) {
  display.drawBitmap(0, 0, bitmap, 128, 64, 1);
}

// ======================
// CÁC HÀM LOGIC GAME
// ======================

/**
 * @brief Đặt lại trạng thái game về ban đầu
 */
void resetGame() {
  score = 0;
  misses = 0;
  gameOver = false;
  mouse_x = 0;
  mouse_direction = 1;
  mouse_move_delay = 50; // Tốc độ ban đầu
  cat_state = RESTING;
  hit_effect_active = false;

  display.clearDisplay();
  display.setTextSize(2);
  display.setTextColor(SH110X_WHITE);
  display.setCursor(20, 20);
  display.println("READY?");
  display.display();
  delay(1500);
}

/**
 * @brief Cập nhật vị trí của chuột
 */
void updateMouse(unsigned long current_time) {
  if (current_time - mouse_last_move > mouse_move_delay) {
    mouse_last_move = current_time;
    mouse_x += mouse_direction;

    // Đổi chiều khi chạm 2 biên
    if (mouse_x <= 0 || mouse_x >= SCREEN_WIDTH - mouse_width) {
      mouse_direction *= -1;
      mouse_x = constrain(mouse_x, 0, SCREEN_WIDTH - mouse_width);
    }
  }
}

/**
 * @brief Cập nhật trạng thái mèo (đưa tay về sau khi đập)
 */
void updateCatState(unsigned long current_time) {
  if (cat_state != RESTING && (current_time - paw_down_timer > paw_down_duration)) {
    cat_state = RESTING;
  }
}

/**
 * @brief Kích hoạt hiệu ứng "vang" tại vị trí (x, y)
 */
void triggerHitEffect(int x, int y) {
  hit_effect_active = true;
  hit_effect_x = x;
  hit_effect_y = y;
  hit_effect_timer = millis();
}

/**
 * @brief Tắt hiệu ứng "vang" sau một khoảng thời gian
 */
void updateHitEffect(unsigned long current_time) {
  if (hit_effect_active && (current_time - hit_effect_timer > hit_effect_duration)) {
    hit_effect_active = false;
  }
}

/**
 * @brief Kiểm tra xem cú đập có trúng chuột không
 * @param checkLeft Kiểm tra cú đập bên trái
 * @param checkRight Kiểm tra cú đập bên phải
 */
void checkHit(bool checkLeft, bool checkRight) {
  bool mouse_hit = false;
  // Tính vị trí trung tâm của con chuột
  int mouse_center_x = mouse_x + (mouse_width / 2);

  if (checkLeft) {   
    if (mouse_center_x >= VISUAL_LEFT_X_START && mouse_center_x <= VISUAL_LEFT_X_END) {
      mouse_hit = true;
      triggerHitEffect( (VISUAL_LEFT_X_START + VISUAL_LEFT_X_END) / 2, mouse_y + mouse_height / 2 );
    }
  }

  if (checkRight) {
    if (mouse_center_x >= VISUAL_RIGHT_X_START && mouse_center_x <= VISUAL_RIGHT_X_END) {
      mouse_hit = true;
      triggerHitEffect( (VISUAL_RIGHT_X_START + VISUAL_RIGHT_X_END) / 2, mouse_y + mouse_height / 2 );
    }
  }

  // Xử lý kết quả 
  if (mouse_hit) {
    score++;
    // Tăng tốc mỗi 5 điểm
    if (score > 0 && score % 5 == 0) {
      mouse_move_delay = max(10, mouse_move_delay - 10); // Giảm delay (tăng tốc), min là 10
    }
    // Đặt lại vị trí chuột
    //mouse_x = 0;
    mouse_x = random(0,127);
    mouse_direction = random(2) == 0 ? -1 : 1;
    mouse_last_move = millis();
  } 
  else { // Đập hụt!
    misses++;
    if (misses >= max_misses) {
      gameOver = true;
    }
  }
}

/**
 * @brief Xử lý input từ người chơi
 */
void handleInput(unsigned long current_time) {
  // Chỉ nhận input khi mèo đang nghỉ (tránh spam)
  if (cat_state != RESTING) return;

  bool leftPressed  = (digitalRead(BTN_LEFT)  == LOW);
  bool rightPressed = (digitalRead(BTN_RIGHT) == LOW);

  if (leftPressed && rightPressed) {
    cat_state = BOTH_PAWS;
    paw_down_timer = current_time;
    checkHit(true, true); // Kiểm tra cả 2 tay
  } 
  else if (leftPressed) {
    cat_state = LEFT_PAW;
    paw_down_timer = current_time;
    checkHit(true, false); // Chỉ kiểm tra tay trái
  } 
  else if (rightPressed) {
    cat_state = RIGHT_PAW;
    paw_down_timer = current_time;
    checkHit(false, true); // Chỉ kiểm tra tay phải
  }
  // Nếu không nhấn gì, không làm gì cả (và không tính là hụt)
}

/**
 * @brief Vẽ toàn bộ cảnh game (mèo, chuột, UI, hiệu ứng)
 */
void drawGame() {
  display.clearDisplay();

  // 1. Vẽ mèo
  switch (cat_state) {
    case RESTING:
      showCat(catIdle);
      break;
    case LEFT_PAW:
      // Nút trái (LEFT_PAW) phải hiển thị tay PHẢI của mèo (catRightPaw)
      // vì đó là tay bên trái màn hình.
      showCat(catRightPaw); 
      break;
    case RIGHT_PAW:
      // Nút phải (RIGHT_PAW) phải hiển thị tay TRÁI của mèo (catLeftPaw)
      // vì đó là tay bên phải màn hình.
      showCat(catLeftPaw);
      break;
    case BOTH_PAWS:
      showCat(catBothPaws);
      break;
  }

  // 2. Vẽ chuột (dùng hình chữ nhật đơn giản)
  display.fillRect(mouse_x, mouse_y, mouse_width, mouse_height, SH110X_WHITE);

  
  // 3. Vẽ hiệu ứng "vang" nếu đang active
  if (hit_effect_active) {
    // Vẽ 2 vòng tròn đồng tâm
    display.drawCircle(hit_effect_x, hit_effect_y, 4, SH110X_WHITE);
    display.drawCircle(hit_effect_x, hit_effect_y, 8, SH110X_WHITE);
  }

  // 4. Vẽ UI (Điểm và Mạng)
  display.setTextSize(1);
  display.setTextColor(SH110X_WHITE);
  display.setCursor(0, 0);
  display.print("Score: ");
  display.print(score);

  display.setCursor(72, 0);
  display.print("Miss: ");
  display.print(misses);
  display.print("/");
  display.print(max_misses);
  
  // 5. Hiển thị lên màn hình
  display.display();
}
/**
 * @brief Vẽ màn hình Game Over
 */
void drawGameOverScreen() {
  display.clearDisplay();
  
  display.setTextSize(2);
  display.setTextColor(SH110X_WHITE);
  display.setCursor(10, 15);
  display.println("GAME OVER");

  display.setTextSize(1);
  display.setCursor(25, 35);
  display.print("Score: ");
  display.print(score);

  display.setCursor(15, 50);
  display.print("Press to retry");
  
  display.display();
  delay(500);
}


// ======================
// SETUP
// ======================
void setup() {
  Serial.begin(115200);
  Wire.begin(); // SDA=21, SCL=22 (mặc định ESP32 DevKit)

  pinMode(BTN_LEFT, INPUT_PULLUP);
  pinMode(BTN_RIGHT, INPUT_PULLUP);

  if(!display.begin(I2C_ADDRESS, true)) {
    Serial.println("Không tìm thấy OLED!");
    while(true);
  }

  // Hiển thị màn hình chờ ban đầu
  resetGame();
}


void loop() {
  unsigned long current_time = millis();

  // 1. Nếu đang Game Over
  if (gameOver) {
    drawGameOverScreen();
    // Chờ nhấn nút để chơi lại
    bool leftPressed  = (digitalRead(BTN_LEFT)  == LOW);
    bool rightPressed = (digitalRead(BTN_RIGHT) == LOW);
    if (leftPressed || rightPressed) {
      delay(500); // Chờ 0.5s để tránh nhấn đúp
      resetGame();
    }
    return; // Dừng vòng lặp ở đây
  }

  // 2. Giới hạn tốc độ khung hình (FPS)
  if (current_time - last_frame_time < frame_delay) {
    return; // Chưa đến lúc vẽ khung hình mới
  }
  last_frame_time = current_time;

  // 3. Chạy các logic chính của game
  handleInput(current_time);
  updateMouse(current_time);
  updateCatState(current_time);
  updateHitEffect(current_time);
  
  // 4. Vẽ tất cả mọi thứ
  drawGame();
}